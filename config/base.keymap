
#include <behaviors.dtsi>
#include <dt-bindings/zmk/keys.h>
#include <dt-bindings/zmk/bt.h>
#include <dt-bindings/zmk/ext_power.h>

// help
#include "../zmk-nodefree-config/helper.h"
#define Hyper(X)  &kp LS(LC(LA(LG(X))))
#define HyperPB &kp LS(LC(LA(LG(PAUSE_BREAK))))
#define EXT_EP_TOG &ext_power EP_TOG
#define trans1 &trans
#define trans2 &trans &trans
#define trans3 &trans &trans &trans
#define trans6 &trans &trans &trans &trans &trans &trans
#define none1 &none
#define none2 &none &none
#define none3 &none &none &none
#define none4 &none &none &none &none
#define none5 &none &none &none &none &none
#define none6 &none &none &none &none &none &none

// Define layer numbers
#define BASE_QWERTY 0
#define BASE_COLEMAK 1
#define BASE_DVORAK 2
#define NUM_NAV 3
#define SYMBOL 4
#define FUNC_MOUSEKEY 5
#define RAYCAST_SHORTCUT_1 6
#define RAYCAST_SHORTCUT_2 7
// 亮度，声音，macro
#define MEDIA_EXT 8
// idea debug
#define DEBUG 9
#define SYS 10
#define MOUSE_TP 11
#define MOUSE_SET 12

#ifdef HAS_MOUSE_KEYS
     #include "feature/mouse_keys.dtsi"
     #define _MKP_ &mkp RCLK &mkp MCLK &mkp LCLK
     #define _MSC_ &msc SCRL_LEFT &msc SCRL_UP &msc SCRL_DOWN &msc SCRL_RIGHT
     #define _MMV_ &mmv MOVE_LEFT &mmv MOVE_DOWN &mmv MOVE_UP &mmv MOVE_RIGHT
#else 
     #define _MKP_ &trans &trans &trans
     #define _MSC_ &trans &trans &trans &trans
     #define _MMV_ &trans &trans &trans &trans
#endif

#ifdef HAS_MOUSE_TP
     #include "feature/mouse_tp.dtsi"
#endif
#include "feature/conditional_layers.dtsi"
#include "feature/combos.dtsi"
#include "feature/behaviours_other.dtsi"

ZMK_BEHAVIOR(moleader, hold_tap,
    flavor = "balanced";
    tapping-term-ms = <200>;
    bindings = <&mo>, <&kp>;
)
#define MO_SYMBOL &moleader SYMBOL SPACE
#define MO_NUM_NAV &moleader NUM_NAV SPACE

ZMK_LAYER(base_qwerty,
// ╭─────────────┬─────────────┬─────────────┬─────────────┬─────────────┬─────────────╮           ╭─────────────┬─────────────┬─────────────┬─────────────┬─────────────┬─────────────╮
     &kp TAB       &kp Q         &kp W         &kp E         &kp R         &kp T                     &kp Y         &kp U         &kp I         &kp O         &kp P         &kp BSPC
// ├─────────────┼─────────────┼─────────────┼─────────────┼─────────────┼─────────────┤           ├─────────────┼─────────────┼─────────────┼─────────────┼─────────────┼─────────────┤
     &kp LCTRL     &kp A         &kp S         &kp D         &kp F         &kp G                     &kp H         &kp J         &kp K         &kp L         &kp SEMI      &kp SQT
// ├─────────────┼─────────────┼─────────────┼─────────────┼─────────────┼─────────────┤           ├─────────────┼─────────────┼─────────────┼─────────────┼─────────────┼─────────────┤
     &kp LSHFT     &kp Z         &kp X         &kp C         &kp V         &kp B                     &kp N         &kp M         &kp COMMA     &kp DOT       &kp SLASH     &kp RSHFT
// ╰─────────────┴─────────────┴─────────────┼─────────────┼─────────────┼─────────────┤           ├─────────────┼─────────────┼─────────────┼─────────────┴─────────────┴─────────────╯
                                               &kp LGUI      MO_SYMBOL     &kp SPACE                 &kp RET       MO_NUM_NAV    &kp RCTRL     
//                                           ╰─────────────┴─────────────┴─────────────╯           ╰─────────────┴─────────────┴─────────────╯
)

ZMK_LAYER(base_colemak,
// ╭─────────────┬─────────────┬─────────────┬─────────────┬─────────────┬─────────────╮           ╭─────────────┬─────────────┬─────────────┬─────────────┬─────────────┬─────────────╮
     &kp TAB       &kp Q         &kp W         &kp F         &kp P         &kp G                     &kp J         &kp L         &kp U         &kp Y         &kp SEMI      &kp BSPC
// ├─────────────┼─────────────┼─────────────┼─────────────┼─────────────┼─────────────┤           ├─────────────┼─────────────┼─────────────┼─────────────┼─────────────┼─────────────┤
     &kp LCTRL     &kp A         &kp R         &kp S         &kp T         &kp D                     &kp H         &kp N         &kp E         &kp I         &kp O         &kp SQT
// ├─────────────┼─────────────┼─────────────┼─────────────┼─────────────┼─────────────┤           ├─────────────┼─────────────┼─────────────┼─────────────┼─────────────┼─────────────┤
     &kp LSHFT     &kp Z         &kp X         &kp C         &kp V         &kp B                     &kp K         &kp M         &kp COMMA     &kp DOT       &kp SLASH     &kp RSHFT
// ╰─────────────┴─────────────┴─────────────┼─────────────┼─────────────┼─────────────┤           ├─────────────┼─────────────┼─────────────┼─────────────┴─────────────┴─────────────╯
                                               &kp LGUI      MO_SYMBOL     &kp SPACE                 &kp RET       MO_NUM_NAV    &kp RCTRL     
//                                           ╰─────────────┴─────────────┴─────────────╯           ╰─────────────┴─────────────┴─────────────╯
)

ZMK_LAYER(base_dvorak,
// ╭─────────────┬─────────────┬─────────────┬─────────────┬─────────────┬─────────────╮           ╭─────────────┬─────────────┬─────────────┬─────────────┬─────────────┬─────────────╮
     &kp TAB       &kp SQT       &kp COMMA     &kp DOT       &kp P         &kp Y                     &kp F         &kp G         &kp C         &kp R         &kp L         &kp BSPC
// ├─────────────┼─────────────┼─────────────┼─────────────┼─────────────┼─────────────┤           ├─────────────┼─────────────┼─────────────┼─────────────┼─────────────┼─────────────┤
     &kp LCTRL     &kp A         &kp O         &kp E         &kp U         &kp I                     &kp D         &kp H         &kp T         &kp N         &kp S         &kp SLASH
// ├─────────────┼─────────────┼─────────────┼─────────────┼─────────────┼─────────────┤           ├─────────────┼─────────────┼─────────────┼─────────────┼─────────────┼─────────────┤
     &kp LSHFT     &kp SEMI      &kp Q         &kp J         &kp K         &kp X                     &kp B         &kp M         &kp W         &kp V         &kp Z         &kp RSHFT
// ╰─────────────┴─────────────┴─────────────┼─────────────┼─────────────┼─────────────┤           ├─────────────┼─────────────┼─────────────┼─────────────┴─────────────┴─────────────╯
                                               &kp LGUI      MO_SYMBOL     &kp SPACE                 &kp RET       MO_NUM_NAV    &kp RCTRL     
//                                           ╰─────────────┴─────────────┴─────────────╯           ╰─────────────┴─────────────┴─────────────╯
)

ZMK_LAYER(num_nav,
// ╭─────────────┬─────────────┬─────────────┬─────────────┬─────────────┬─────────────╮           ╭─────────────┬─────────────┬─────────────┬─────────────┬─────────────┬─────────────╮
     &kp CAPS      &kp N1        &kp N2        &kp N3        &kp N4        &kp N5                    &kp N6        &kp N7        &kp N8        &kp N9        &kp N0        trans1
// ├─────────────┼─────────────┼─────────────┼─────────────┼─────────────┼─────────────┤           ├─────────────┼─────────────┼─────────────┼─────────────┼─────────────┼─────────────┤
     trans3                                    &td_debug     &kp RC(SPACE) trans1                    &kp LEFT      &kp DOWN      &kp UP        &kp RIGHT     trans2         
// ├─────────────┼─────────────┼─────────────┼─────────────┼─────────────┼─────────────┤           ├─────────────┼─────────────┼─────────────┼─────────────┼─────────────┼─────────────┤
     trans6                                                                                          trans6
// ╰─────────────┴─────────────┴─────────────┼─────────────┼─────────────┼─────────────┤           ├─────────────┼─────────────┼─────────────┼─────────────┴─────────────┴─────────────╯
                                               trans3                                                trans3     
//                                           ╰─────────────┴─────────────┴─────────────╯           ╰─────────────┴─────────────┴─────────────╯
)

ZMK_LAYER(symbol,
// ╭─────────────┬─────────────┬─────────────┬─────────────┬─────────────┬─────────────╮           ╭─────────────┬─────────────┬─────────────┬─────────────┬─────────────┬─────────────╮
     trans1        &kp EXCL      &kp AT        &kp POUND     &kp DLLR      &kp PRCNT                 &kp CARET     &kp AMPS      &kp STAR      &kp LPAR      &kp RPAR      &kp ESC
// ├─────────────┼─────────────┼─────────────┼─────────────┼─────────────┼─────────────┤           ├─────────────┼─────────────┼─────────────┼─────────────┼─────────────┼─────────────┤
     trans2                      _MKP_                                     trans1                    &kp GRAVE     &kp MINUS     &kp EQUAL     &kp LBKT      &kp RBKT      &kp BSLH
// ├─────────────┼─────────────┼─────────────┼─────────────┼─────────────┼─────────────┤           ├─────────────┼─────────────┼─────────────┼─────────────┼─────────────┼─────────────┤
     trans6                                                                                          &kp TILDE     &kp UNDER     &kp PLUS      &kp LBRC      &kp RBRC      &kp PIPE
// ╰─────────────┴─────────────┴─────────────┼─────────────┼─────────────┼─────────────┤           ├─────────────┼─────────────┼─────────────┼─────────────┴─────────────┴─────────────╯
                                               trans3                                                trans3                                                                                                                                              
//                                           ╰─────────────┴─────────────┴─────────────╯           ╰─────────────┴─────────────┴─────────────╯
)

ZMK_LAYER(func_mousekey,
// ╭─────────────┬─────────────┬─────────────┬─────────────┬─────────────┬─────────────╮           ╭─────────────┬─────────────┬─────────────┬─────────────┬─────────────┬─────────────╮
     trans1        &kp F1        &kp F2        &kp F3        &kp F4        &kp F5                    &kp F6        &kp F7        &kp F8        &kp F9        &kp F10       &kp F11
// ├─────────────┼─────────────┼─────────────┼─────────────┼─────────────┼─────────────┤           ├─────────────┼─────────────┼─────────────┼─────────────┼─────────────┼─────────────┤
     trans6                                                                                          _MSC_                                                   trans1        &kp F12
// ├─────────────┼─────────────┼─────────────┼─────────────┼─────────────┼─────────────┤           ├─────────────┼─────────────┼─────────────┼─────────────┼─────────────┼─────────────┤
     trans6                                                                                          _MMV_                                                   trans2
// ╰─────────────┴─────────────┴─────────────┼─────────────┼─────────────┼─────────────┤           ├─────────────┼─────────────┼─────────────┼─────────────┴─────────────┴─────────────╯
                                               trans3                                                trans3       
//                                           ╰─────────────┴─────────────┴─────────────╯           ╰─────────────┴─────────────┴─────────────╯
)

ZMK_LAYER(sk_1,
// ╭─────────────┬─────────────┬─────────────┬─────────────┬─────────────┬─────────────╮           ╭─────────────┬─────────────┬─────────────┬─────────────┬─────────────┬─────────────╮
     Hyper(A)      Hyper(B)      Hyper(C)      Hyper(D)      Hyper(E)      Hyper(F)                  Hyper(G)      Hyper(H)      Hyper(I)      Hyper(J)      Hyper(K)      Hyper(L)
// ├─────────────┼─────────────┼─────────────┼─────────────┼─────────────┼─────────────┤           ├─────────────┼─────────────┼─────────────┼─────────────┼─────────────┼─────────────┤
     Hyper(M)      Hyper(N)      Hyper(O)      Hyper(P)      Hyper(LNLCK)  Hyper(R)                  Hyper(S)      Hyper(T)      Hyper(U)      Hyper(V)      Hyper(W)      Hyper(X)
// ├─────────────┼─────────────┼─────────────┼─────────────┼─────────────┼─────────────┤           ├─────────────┼─────────────┼─────────────┼─────────────┼─────────────┼─────────────┤
     Hyper(Y)      Hyper(Z)      Hyper(N1)     Hyper(N2)     Hyper(N3)     Hyper(N4)                 Hyper(N5)     Hyper(N6)     Hyper(N7)     Hyper(N8)     Hyper(N9)     Hyper(N0)
// ╰─────────────┴─────────────┴─────────────┼─────────────┼─────────────┼─────────────┤           ├─────────────┼─────────────┼─────────────┼─────────────┴─────────────┴─────────────╯
                                               none3                                                 none3
//                                           ╰─────────────┴─────────────┴─────────────╯           ╰─────────────┴─────────────┴─────────────╯
)

ZMK_LAYER(sk_2,
// ╭─────────────┬─────────────┬─────────────┬─────────────┬─────────────┬─────────────╮           ╭─────────────┬─────────────┬─────────────┬─────────────┬─────────────┬─────────────╮
     Hyper(F1)     Hyper(F2)     Hyper(F3)     Hyper(F4)     Hyper(F5)     Hyper(F6)                 Hyper(F7)     Hyper(F8)     Hyper(F9)     Hyper(F10)    Hyper(F11)    Hyper(F12)
// ├─────────────┼─────────────┼─────────────┼─────────────┼─────────────┼─────────────┤           ├─────────────┼─────────────┼─────────────┼─────────────┼─────────────┼─────────────┤
     Hyper(INS)    Hyper(HOME)   Hyper(PG_UP)  Hyper(DEL)    Hyper(END)    Hyper(PG_DN)              Hyper(GRAVE)  Hyper(MINUS)  Hyper(EQUAL)  Hyper(LBKT)   Hyper(RBKT)   Hyper(BSLH)
// ├─────────────┼─────────────┼─────────────┼─────────────┼─────────────┼─────────────┤           ├─────────────┼─────────────┼─────────────┼─────────────┼─────────────┼─────────────┤
     Hyper(SEMI)   Hyper(SQT)    Hyper(PSCRN)  Hyper(SLCK)   HyperPB       Hyper(UP)                 Hyper(DOWN)   Hyper(LEFT)   Hyper(RIGHT)  Hyper(RET)    Hyper(SPACE)  Hyper(TAB)
// ╰─────────────┴─────────────┴─────────────┼─────────────┼─────────────┼─────────────┤           ├─────────────┼─────────────┼─────────────┼─────────────┴─────────────┴─────────────╯
                                               none3                                                 none3
//                                           ╰─────────────┴─────────────┴─────────────╯           ╰─────────────┴─────────────┴─────────────╯
)

ZMK_LAYER(media_ext,
// ╭─────────────┬─────────────┬─────────────┬─────────────┬─────────────┬─────────────╮           ╭─────────────┬─────────────┬─────────────┬─────────────┬─────────────┬─────────────╮
     none6                                                                                           none2                       &kp C_MUTE     none3                                 
// ├─────────────┼─────────────┼─────────────┼─────────────┼─────────────┼─────────────┤           ├─────────────┼─────────────┼─────────────┼─────────────┼─────────────┼─────────────┤
     none6                                                                                           none1         &kp C_BRI_UP  &kp C_VOL_UP  none3
// ├─────────────┼─────────────┼─────────────┼─────────────┼─────────────┼─────────────┤           ├─────────────┼─────────────┼─────────────┼─────────────┼─────────────┼─────────────┤
     EXT_EP_TOG    &kp C_SLEEP   none4                                                               none1         &kp C_BRI_DN  &kp C_VOL_DN  none3
// ╰─────────────┴─────────────┴─────────────┼─────────────┼─────────────┼─────────────┤           ├─────────────┼─────────────┼─────────────┼─────────────┴─────────────┴─────────────╯
                                               none1         &tog MEDIA_EXT none1                    none1         &tog MEDIA_EXT none1
//                                           ╰─────────────┴─────────────┴─────────────╯           ╰─────────────┴─────────────┴─────────────╯
)

// LA(F9) run to cursor
// LA(LG(R)) resume program
ZMK_LAYER(debug,
// ╭─────────────┬─────────────┬─────────────┬─────────────┬─────────────┬─────────────╮           ╭─────────────┬─────────────┬─────────────┬─────────────┬─────────────┬─────────────╮
     none3                                     &td_d_eval    &td_d_run     none1                     none6                       
// ├─────────────┼─────────────┼─────────────┼─────────────┼─────────────┼─────────────┤           ├─────────────┼─────────────┼─────────────┼─────────────┼─────────────┼─────────────┤
     none3                                     &td_d_d       none1         &kp LA(F9)                none1         &kp F7        &kp LS(F8)    none2
// ├─────────────┼─────────────┼─────────────┼─────────────┼─────────────┼─────────────┤           ├─────────────┼─────────────┼─────────────┼─────────────┼─────────────┼─────────────┤
     none5                                                                 &td_d_bp                  none1         &td_d_bm      none4
// ╰─────────────┴─────────────┴─────────────┼─────────────┼─────────────┼─────────────┤           ├─────────────┼─────────────┼─────────────┼─────────────┴─────────────┴─────────────╯
                                               none1         &tog DEBUG    none1                     none1         &tog DEBUG    none1
//                                           ╰─────────────┴─────────────┴─────────────╯           ╰─────────────┴─────────────┴─────────────╯
)

ZMK_LAYER(sys,
// ╭─────────────┬─────────────┬─────────────┬─────────────┬─────────────┬─────────────╮           ╭─────────────┬─────────────┬─────────────┬─────────────┬─────────────┬─────────────╮
     &sys_reset    &bootloader   none1         &bt BT_PRV    &bt BT_NXT    &td_out_bc                &td_out_bc    &bt BT_PRV     &bt BT_NXT   none1         &bootloader   &sys_reset                      
// ├─────────────┼─────────────┼─────────────┼─────────────┼─────────────┼─────────────┤           ├─────────────┼─────────────┼─────────────┼─────────────┼─────────────┼─────────────┤
     none6                                                                                           none1         &kp C_BRI_UP  &kp C_VOL_UP  none3
// ├─────────────┼─────────────┼─────────────┼─────────────┼─────────────┼─────────────┤           ├─────────────┼─────────────┼─────────────┼─────────────┼─────────────┼─────────────┤
     EXT_EP_TOG    &kp C_SLEEP   none4                                                               none1         &kp C_BRI_DN  &kp C_VOL_DN  none1         &kp C_SLEEP   EXT_EP_TOG
// ╰─────────────┴─────────────┴─────────────┼─────────────┼─────────────┼─────────────┤           ├─────────────┼─────────────┼─────────────┼─────────────┴─────────────┴─────────────╯
                                               none1         &tog SYS      none1                     none1         &tog SYS      none1
//                                           ╰─────────────┴─────────────┴─────────────╯           ╰─────────────┴─────────────┴─────────────╯
)

#if defined(HAS_MOUSE_KEYS) && defined(HAS_MOUSE_TP)

ZMK_LAYER(mouse_tp,
// ╭─────────────┬─────────────┬─────────────┬─────────────┬─────────────┬─────────────╮           ╭─────────────┬─────────────┬─────────────┬─────────────┬─────────────┬─────────────╮
     trans6                                                                                          trans6
// ├─────────────┼─────────────┼─────────────┼─────────────┼─────────────┼─────────────┤           ├─────────────┼─────────────┼─────────────┼─────────────┼─────────────┼─────────────┤
     trans2                      _MKP_                                     trans1                    trans6
// ├─────────────┼─────────────┼─────────────┼─────────────┼─────────────┼─────────────┤           ├─────────────┼─────────────┼─────────────┼─────────────┼─────────────┼─────────────┤
     trans6                                                                                          trans6
// ╰─────────────┴─────────────┴─────────────┼─────────────┼─────────────┼─────────────┤           ├─────────────┼─────────────┼─────────────┼─────────────┴─────────────┴─────────────╯
                                               trans1        &tog MOUSE_TP trans1                    trans1          &tog MOUSE_TP trans1
//                                           ╰─────────────┴─────────────┴─────────────╯           ╰─────────────┴─────────────┴─────────────╯
)

ZMK_LAYER(mouse_set,
// ╭─────────────┬─────────────┬─────────────┬─────────────┬─────────────┬─────────────╮           ╭─────────────┬─────────────┬─────────────┬─────────────┬─────────────┬─────────────╮
     none3                                     U_MSS_TP_S_D  U_MSS_TP_S_I  U_MSS_TP_PT_I             none5                                                                 U_MSS_RESET
// ├─────────────┼─────────────┼─────────────┼─────────────┼─────────────┼─────────────┤           ├─────────────┼─────────────┼─────────────┼─────────────┼─────────────┼─────────────┤
     none3                                     U_MSS_TP_NI_D U_MSS_TP_NI_I U_MSS_TP_PT_D             none5                                                                 U_MSS_LOG 
// ├─────────────┼─────────────┼─────────────┼─────────────┼─────────────┼─────────────┤           ├─────────────┼─────────────┼─────────────┼─────────────┼─────────────┼─────────────┤
     none3                                     U_MSS_TP_V6_D U_MSS_TP_V6_I none1                     none6                                 
// ╰─────────────┴─────────────┴─────────────┼─────────────┼─────────────┼─────────────┤           ├─────────────┼─────────────┼─────────────┼─────────────┴─────────────┴─────────────╯
                                               none1         &tog MOUSE_SET none1                    none1         &tog MOUSE_SET none1
//                                           ╰─────────────┴─────────────┴─────────────╯           ╰─────────────┴─────────────┴─────────────╯
)

#endif
